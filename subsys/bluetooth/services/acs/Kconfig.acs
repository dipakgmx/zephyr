## subsys/bluetooth/services/acs/Kconfig.acs
```kconfig
# Bluetooth GATT Authorization Control Service

config BT_ACS
	bool "GATT Authorization Control Service"
	depends on BT_CONN
	depends on PSA_CRYPTO
	depends on MBEDTLS
	depends on !BT_GATT_DYNAMIC_DB
	select EXPERIMENTAL
	help
	  Enable GATT Authorization Control Service (UUID 0x183D).
	  This service provides application-level security for Bluetooth LE resources,
	  requiring an Authorization Control (AC) Client to successfully authenticate
	  to access specific, protected GATT resources of an AC Server.

if BT_ACS

module = BT_ACS
module-str = BT_ACS
source "subsys/logging/Kconfig.template.log_config"

menu "ACS Protection Methods"

config BT_ACS_FEAT_AUTHORIZATION
	bool "Authorization support (Restriction Maps)"
	depends on BT_ACS_FEAT_AUTHENTICATION
	select BT_GATT_AUTHORIZATION_CUSTOM
	select BT_GATT_TX_INTERCEPT
	default y
	help
	  Support authorization information security controls
	  (ACS 1.0 Table 4.61): restriction maps and the Get Restriction
	  Map Descriptor (0x02) and Get Restriction Map ID List (0x04)
	  procedures.

	  The application defines the maps with
	  BT_ACS_RESTRICTION_MAP_DEFINE() and names the one active at start
	  with BT_ACS_INITIAL_RESTRICTION_MAP(). AC Clients cache a map by
	  its ID (ACS 1.0 Section 3.5.3), so give a map a new ID whenever
	  its content changes.

config BT_ACS_FEAT_AUTHENTICATION
	bool "Authentication support"
	depends on BT_SETTINGS
	select PSA_WANT_ALG_ECDH
	select PSA_WANT_ALG_HKDF
	select PSA_WANT_ALG_HMAC
	select PSA_WANT_ALG_SHA_256
	select PSA_WANT_KEY_TYPE_DERIVE
	select PSA_WANT_KEY_TYPE_HMAC
	select PSA_WANT_KEY_TYPE_ECC_KEY_PAIR_IMPORT
	select PSA_WANT_KEY_TYPE_ECC_KEY_PAIR_GENERATE
	select PSA_WANT_KEY_TYPE_ECC_KEY_PAIR_EXPORT
	select PSA_WANT_ECC_SECP_R1_256
	default y
	help
	  Support authentication information security controls
	  (ACS 1.0 Table 4.61).
	  Adds both key-exchange methods and the protected Data In/Out
	  channel, using Curve P-256 with HKDF SHA-256 128-bit (ACP 1.0
	  Section 4.1.1.1). Integrity, confidentiality and authorization
	  depend on it.

	  Each bonded peer's ECDH key is kept as a persistent PSA key, so
	  the PSA Crypto provider needs key storage (CONFIG_SECURE_STORAGE
	  with Mbed TLS).

config BT_ACS_FEAT_INTEGRITY
	bool "Integrity support"
	depends on BT_ACS_FEAT_AUTHENTICATION
	default y
	help
	  Support integrity information security controls
	  (ACS 1.0 Table 4.61).

config BT_ACS_FEAT_CONFIDENTIALITY
	bool "Confidentiality support"
	depends on BT_ACS_FEAT_INTEGRITY
	default y
	help
	  Support confidentiality using encryption information security
	  controls (ACS 1.0 Table 4.61).

endmenu # ACS Protection Methods

menu "Confirmation Capabilities"
	depends on BT_ACS_FEAT_AUTHENTICATION

config BT_ACS_CONFIRMATION_OUTPUT_NUMERIC
	bool "Numeric output display"
	help
	  Advertise support for numeric output OOB confirmation
	  (BIT(3) of Confirmation_Output_OOB_Number_Capabilities).

config BT_ACS_CONFIRMATION_INPUT_NUMERIC
	bool "Numeric input"
	help
	  Advertise support for numeric input OOB confirmation
	  (BIT(2) of Confirmation_Input_OOB_Number_Capabilities).

config BT_ACS_CONFIRMATION_INPUT_PUSH
	bool "Push input"
	help
	  Advertise support for push input OOB confirmation
	  (BIT(0) of Confirmation_Input_OOB_Number_Capabilities).

endmenu # Confirmation Capabilities

# Outside the menu above: the ACS Feature Response reports them, as 0 when
# unused.

config BT_ACS_CONFIRMATION_OUTPUT_MAX_VALUE
	int
	prompt "Maximum Output OOB Number" if BT_ACS_CONFIRMATION_OUTPUT_NUMERIC
	default 999999 if BT_ACS_CONFIRMATION_OUTPUT_NUMERIC
	default 0
	range 1 999999999 if BT_ACS_CONFIRMATION_OUTPUT_NUMERIC
	help
	  Confirmation_Output_OOB_Number_Maximum_Value (ACS 1.0 Section 4.4.4.27.7):
	  the Output OOB Number is picked between 1 and this value.

config BT_ACS_CONFIRMATION_INPUT_MAX_VALUE
	int
	prompt "Maximum Input OOB Number" if BT_ACS_CONFIRMATION_INPUT_NUMERIC || \
		BT_ACS_CONFIRMATION_INPUT_PUSH
	default 999999 if BT_ACS_CONFIRMATION_INPUT_NUMERIC
	default 9 if BT_ACS_CONFIRMATION_INPUT_PUSH
	default 0
	range 1 999999999 if BT_ACS_CONFIRMATION_INPUT_NUMERIC || \
		BT_ACS_CONFIRMATION_INPUT_PUSH
	help
	  Confirmation_Input_OOB_Number_Maximum_Value (ACS 1.0 Section 4.4.4.27.5):
	  the user enters a number between 1 and this value, as digits for
	  Input Numeric and as a count of pushes for Input Push.

config BT_ACS_ATT_MTU
	bool "Get ATT_MTU procedure"
	default y
	help
	  Support the Get ATT_MTU procedure (ACS 1.0 Section 4.4.3.19) and
	  indicate the new ATT_MTU to an AC Client when it changes.

menu "Security Management Procedures"

config BT_ACS_SET_SECURITY_CONTROLS_SWITCH
	bool "Set Security Controls Switch procedure"
	depends on BT_ACS_FEAT_AUTHENTICATION
	help
	  Let an AC Client change the state of the security controls
	  switch (ACS 1.0 Section 4.4.3.14).

	  Enable only where the procedure itself is access-controlled;
	  unprotected, it lets a client turn off ACS enforcement.

config BT_ACS_INITIATE_PAIRING
	bool "Initiate Pairing procedure"
	depends on BT_ACS_FEAT_AUTHENTICATION
	depends on BT_SMP
	help
	  Let an AC Client request that the AC Server start LE pairing
	  (ACS 1.0 Section 4.4.3.20), and set the Initiation of Pairing
	  Supported bit in the ACS Feature Response.

endmenu # Security Management Procedures

menu "Data protection algorithms"
	depends on BT_ACS_FEAT_AUTHENTICATION

# No prompt: ACP 1.0 Section 4.1.1.2 requires GCM when confidentiality is
# supported.
config BT_ACS_DATA_PROTECTION_AES_GCM
	bool
	depends on BT_ACS_FEAT_CONFIDENTIALITY
	select PSA_WANT_ALG_GCM
	select PSA_WANT_KEY_TYPE_AES
	default y
	help
	  Authenticated encryption with associated data (ACS 1.0
	  Section 3.6.6.3), with a full 16-octet MAC.

	  12-octet IV: 4-octet fixed part and 8-octet invocation part, in
	  Sequence Number Different Fixed Parts format (ACP 1.0
	  Section 4.1.1.2).

config BT_ACS_DATA_PROTECTION_AES_CCM
	bool "AES-128-CCM (AEAD)"
	depends on BT_ACS_FEAT_CONFIDENTIALITY
	select PSA_WANT_ALG_CCM
	select PSA_WANT_KEY_TYPE_AES
	help
	  Authenticated encryption with associated data (ACS 1.0
	  Section 3.6.6.1), with a MAC of BT_ACS_CCM_MAC_SIZE octets.

	  ACP 1.0 sets no nonce format for CCM. This implementation uses a
	  13-octet nonce: 5-octet fixed part and 8-octet counter part, in
	  Sequence Number Different Fixed Parts format (ACS 1.0
	  Section 4.4.4.15.1.4.4.6).

config BT_ACS_CCM_MAC_SIZE
	int "AES-CCM MAC tag size in bytes"
	depends on BT_ACS_DATA_PROTECTION_AES_CCM
	range 4 16
	default 8
	help
	  Size, in bytes, of the AES-128-CCM authentication tag this server
	  uses, reported in the MAC_Size field of its key descriptor. Must
	  be even; a BUILD_ASSERT enforces it.

	  ACS 1.0 Section 3.6.6.1 allows 4, 6, 8, 10, 12, 14 or 16, but
	  recommends at least a 64-bit MAC against guessing attacks, so
	  values below 8 weaken the configuration.

# No prompt: ACP 1.0 Section 4.1.1.2 requires GMAC when integrity is
# supported without confidentiality.
config BT_ACS_DATA_PROTECTION_AES_GMAC
	bool
	depends on BT_ACS_FEAT_INTEGRITY
	depends on !BT_ACS_FEAT_CONFIDENTIALITY
	select PSA_WANT_ALG_GCM
	select PSA_WANT_KEY_TYPE_AES
	default y
	help
	  The zero-length-plaintext variant of AES-128-GCM (ACS 1.0
	  Section 3.6.6.3): authentication and integrity with no
	  encryption. Same 12-octet IV structure and 16-octet MAC.

# No prompt: the only algorithm without integrity. ACP 1.0 names none for
# this level.
config BT_ACS_DATA_PROTECTION_AES_CMAC
	bool
	depends on !BT_ACS_FEAT_INTEGRITY
	select PSA_WANT_ALG_CMAC
	select PSA_WANT_KEY_TYPE_AES
	default y
	help
	  Message authentication over an unencrypted payload (ACS 1.0
	  Section 3.6.5.1), with a 16-octet MAC. Carries no nonce, so no
	  replay counter is maintained.

endmenu # Data protection algorithms

config BT_ACS_STORE_DELAY_MS
	int "Delay before storing changed nonce fixed parts, in milliseconds"
	depends on BT_ACS_FEAT_AUTHENTICATION
	range 0 60000
	default 1000
	help
	  Each bonded peer's ECDH key is a persistent PSA key; settings
	  hold its PSA key ID and the nonce fixed parts. Changed nonce fixed
	  parts are written this long after the last change, so one key
	  exchange takes one flash write. A reset within the delay loses
	  the latest values. A new ECDH key is stored at once.

config BT_ACS_ANY_DATA_PROTECTION
	bool
	default y if BT_ACS_DATA_PROTECTION_AES_GCM || BT_ACS_DATA_PROTECTION_AES_CCM || \
		BT_ACS_DATA_PROTECTION_AES_GMAC || BT_ACS_DATA_PROTECTION_AES_CMAC

# CMAC carries no nonce, so a CMAC-only build compiles out the nonce-prefix
# machinery and the Set AC Client Nonce Fixed opcode.
config BT_ACS_HAS_NONCE_FIXED
	bool
	default y if BT_ACS_DATA_PROTECTION_AES_CCM || BT_ACS_DATA_PROTECTION_AES_GCM || \
		BT_ACS_DATA_PROTECTION_AES_GMAC

config BT_ACS_MAX_MESSAGE_SIZE
	int "Maximum ACS application message size"
	range 69 483 if BT_ACS_HAS_NONCE_FIXED
	range 69 491 if BT_ACS_FEAT_AUTHENTICATION
	range 69 511
	default 483
	help
	  Largest application message ACS sends or accepts: an ACS Control
	  Point opcode with its operands, or a protected characteristic
	  value. Segmentation and protection fields are not counted, and
	  ATT_MTU does not limit it: a longer message is segmented.

	  The minimum fits every fixed-size message. bt_acs_init() fails
	  when a restriction map, the Restriction Map ID List or the
	  Resource Handle UUID Map response does not fit.

	  Each connection takes 6 buffers of this size plus at most 29
	  octets, which must stay within the 512-octet attribute value
	  limit: at most 483 with AES-GCM, AES-CCM or AES-GMAC, 491 with
	  AES-CMAC and 511 without authentication.

config BT_ACS_WORKQUEUE_STACK_SIZE
	int "ACS workqueue stack size"
	default 2048
	range 1024 8192
	help
	  Stack size, in bytes, of the ACS workqueue. Sized for
	  ACS CP procedure execution, which includes the ECDH key
	  exchange. The PSA Crypto provider runs on this stack, so check
	  its use (CONFIG_THREAD_ANALYZER) when changing the provider.

config BT_ACS_WORKQUEUE_THREAD_PRIO
	int "ACS workqueue thread priority"
	default 10
	help
	  Scheduling priority of the ACS workqueue, which runs
	  ACS CP procedure execution (including ECDH key exchange),
	  protected-request handling, Data Out drain and segmented TX.

endif # BT_ACS
```
