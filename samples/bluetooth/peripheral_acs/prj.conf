## CMakeLists.txt
```
# SPDX-License-Identifier: Apache-2.0

cmake_minimum_required(VERSION 3.20.0)

find_package(Zephyr REQUIRED HINTS $ENV{ZEPHYR_BASE})
project(peripheral_acs)

target_sources(app PRIVATE
  src/main.c
  src/sample_cts.c
  src/sample_hrs.c
)
```

## Kconfig
```
# SPDX-FileCopyrightText: Copyright The Zephyr Project Contributors
# SPDX-License-Identifier: Apache-2.0

mainmenu "Bluetooth: Peripheral ACS sample"

choice SAMPLE_ACS_ISC
	prompt "ISC protecting the sample's resources"
	default SAMPLE_ACS_ISC_GCM if BT_ACS_DATA_PROTECTION_AES_GCM
	default SAMPLE_ACS_ISC_GMAC if BT_ACS_DATA_PROTECTION_AES_GMAC
	default SAMPLE_ACS_ISC_CMAC
	help
	  The ISC that every protected resource of the sample names. ACS lets
	  each restriction map entry name its own ISC; one keeps the sample
	  simple.

	  Defaults follow the protection level: GCM with confidentiality, GMAC
	  with integrity, CMAC otherwise. Select CCM explicitly.

config SAMPLE_ACS_ISC_GCM
	bool "AES-128-GCM (high security)"
	depends on BT_ACS_DATA_PROTECTION_AES_GCM

config SAMPLE_ACS_ISC_CCM
	bool "AES-128-CCM (high security)"
	depends on BT_ACS_DATA_PROTECTION_AES_CCM

config SAMPLE_ACS_ISC_GMAC
	bool "AES-128-GMAC (integrity)"
	depends on BT_ACS_DATA_PROTECTION_AES_GMAC

config SAMPLE_ACS_ISC_CMAC
	bool "AES-128-CMAC (MAC only)"
	depends on BT_ACS_DATA_PROTECTION_AES_CMAC

endchoice

config SAMPLE_ACS_PTS
	bool "Restriction map layout for the ACS PTS test cases"
	help
	  Register a second restriction map, protecting Current Time read and
	  write, Invalidate All Established Security and Set Security Controls
	  Switch, with the sample's ISC as its map ISC. The first map then
	  leaves both procedures on the plain ACS CP, so any client can turn
	  the security controls off. For testing only.

source "Kconfig.zephyr"
```

## sample.yaml
```
sample:
  name: Bluetooth Peripheral ACS
  description: >
    Demonstrates ACS protecting the Current Time Service (CTS) and Heart
    Rate Service (HRS).  See Testing.md for PTS execution order.
    prj.conf is the base configuration: GCM confidentiality with ECDH and
    the standalone KDF key-exchange method. Cipher overlays select the
    data-protection algorithm governing the protected resources.

tests:

  # AES-128-GCM, the prj.conf default
  sample.bluetooth.peripheral_acs.cipher.gcm:
    harness: bluetooth
    platform_allow:
      - frdm_rw612
      - rd_rw612_bga
      - nrf52840dk/nrf52840
    tags: bluetooth acs cipher
    build_only: true
    integration_platforms:
      - frdm_rw612

  sample.bluetooth.peripheral_acs.cipher.ccm:
    harness: bluetooth
    platform_allow:
      - frdm_rw612
      - rd_rw612_bga
      - nrf52840dk/nrf52840
    tags: bluetooth acs cipher
    build_only: true
    extra_args: >-
      EXTRA_CONF_FILE="overlay-cipher-ccm.conf"
    integration_platforms:
      - frdm_rw612

  # Authentication only, no integrity or confidentiality
  sample.bluetooth.peripheral_acs.cipher.cmac:
    harness: bluetooth
    platform_allow:
      - frdm_rw612
      - rd_rw612_bga
      - nrf52840dk/nrf52840
    tags: bluetooth acs cipher
    build_only: true
    extra_args: >-
      EXTRA_CONF_FILE="overlay-cipher-cmac.conf"
    integration_platforms:
      - frdm_rw612

  # Every ECDH confirmation method and action
  sample.bluetooth.peripheral_acs.confirm_oob:
    harness: bluetooth
    platform_allow:
      - frdm_rw612
      - rd_rw612_bga
      - nrf52840dk/nrf52840
    tags: bluetooth acs
    build_only: true
    extra_args: >-
      EXTRA_CONF_FILE="overlay-confirm-oob.conf"
    integration_platforms:
      - frdm_rw612

  # Integrity and authentication, no confidentiality
  sample.bluetooth.peripheral_acs.cipher.gmac:
    harness: bluetooth
    platform_allow:
      - frdm_rw612
      - rd_rw612_bga
      - nrf52840dk/nrf52840
    tags: bluetooth acs cipher
    build_only: true
    extra_args: >-
      EXTRA_CONF_FILE="overlay-cipher-gmac.conf"
    integration_platforms:
      - frdm_rw612
```

## prj.conf
```kconfig
CONFIG_BT=y
CONFIG_LOG=y
CONFIG_BT_SMP=y
CONFIG_BT_PERIPHERAL=y
CONFIG_BT_BONDABLE=y
CONFIG_BT_MAX_PAIRED=4
CONFIG_SECURE_STORAGE=y

# Services
CONFIG_BT_CTS=y
CONFIG_BT_CTS_HELPER_API=y

CONFIG_BT_HRS=y
CONFIG_BT_DIS=y
CONFIG_BT_DIS_PNP=n
CONFIG_BT_ACS=y
CONFIG_BT_ACS_INITIATE_PAIRING=y
CONFIG_BT_ACS_SET_SECURITY_CONTROLS_SWITCH=y
CONFIG_BT_ACS_WORKQUEUE_STACK_SIZE=4096

CONFIG_BT_ACS_CONFIRMATION_OUTPUT_NUMERIC=y

# Bonds, and per peer the ACS ECDH key ID and nonce fixed parts
CONFIG_BT_SETTINGS=y
CONFIG_SETTINGS=y
CONFIG_FLASH=y
CONFIG_FLASH_MAP=y
CONFIG_NVS=y

CONFIG_BT_DEVICE_NAME="ACS CTS HRS Demo"
CONFIG_BT_DEVICE_APPEARANCE=256
CONFIG_STACK_SENTINEL=y
CONFIG_BT_RX_STACK_SIZE=8192

CONFIG_MAIN_STACK_SIZE=4096
CONFIG_THREAD_MONITOR=y
CONFIG_THREAD_NAME=y
CONFIG_ASSERT=y
CONFIG_LOG_BUFFER_SIZE=4096
```

## overlay-bonding.conf
```kconfig
# overlay-bonding.conf — enable ACS session persistence and pairing initiation
#
# Apply on top of prj.conf:
#   west build -b <board> -- -DEXTRA_CONF_FILE=overlay-bonding.conf
#
# With this overlay:
#  - ACS session keys are stored in NVS and restored automatically when a
#    bonded peer reconnects (no key exchange needed on reconnect).
#  - The ACS CP exposes the INITIATE_PAIRING opcode (0xDF) so the client
#    can trigger BLE bonding via the ACS control point after key exchange.

# Expose INITIATE_PAIRING opcode on the ACS Control Point so the client
# can trigger the BLE SMP pairing procedure via ACS.
CONFIG_BT_ACS_INITIATE_PAIRING=y


# Allow more than one bonded peer so that a fresh PTS connection can get a
# key slot even when a previous bond already occupies the default slot.
# Without this, bt_keys_get_addr() returns NULL → -ENOMEM from smp_send_security_req.
CONFIG_BT_MAX_PAIRED=4
```

## overlay-ccm-mac16.conf
```kconfig
# CCM with 16-byte (maximum) MAC tag.
# Compose with overlay-cipher-ccm-difff-fixed.conf or overlay-cipher-ccm-evenodd.conf.
CONFIG_BT_ACS_CCM_MAC_SIZE=16
```

## overlay-ccm-mac4.conf
```kconfig
# CCM with 4-byte (minimum) MAC tag.
# Compose with overlay-cipher-ccm-difff-fixed.conf or overlay-cipher-ccm-evenodd.conf.
CONFIG_BT_ACS_CCM_MAC_SIZE=4
```

## overlay-cipher-ccm-conf-only.conf
```kconfig
# AES-128-CCM — confidentiality only (§3.6.6.1)
#
# Table row 4: Confidentiality without explicit integrity feature.
# ISC controls: Nonce + MAC + Authenticated And Encrypted.
#
# CCM is an AEAD cipher (always produces auth tag), but this overlay
# advertises only the CONFIDENTIALITY feature, not INTEGRITY.
# GMAC is not pulled in (its Kconfig default depends on INTEGRITY).
# Uses even/odd nonce scheme (no Set Client Nonce Fixed required).
#
# Combine with a kex overlay (e.g., overlay-kex-ecdh.conf).

# Disable the default GCM; PSA deps are auto-selected via Kconfig
CONFIG_BT_ACS_DATA_PROTECTION_AES_GCM=n

CONFIG_BT_ACS_FEAT_INTEGRITY=n
CONFIG_BT_ACS_DATA_PROTECTION_AES_CCM=y
CONFIG_BT_ACS_CCM_NONCE_SEQ_EVEN_ODD=y
CONFIG_BT_ACS_CCM_MAC_SIZE=8
```

## overlay-cipher-ccm-diff-fixed.conf
```kconfig
# AES-128-CCM with SEQ_DIFF_FIXED nonce scheme
#
# Replaces the default AES-GCM with AES-128-CCM (AEAD, §3.6) using the
# differential fixed-part nonce scheme (Table 4.47).  Server and client
# each have an 8-byte fixed nonce prefix; the remaining 5 bytes are a
# sequential counter.  Requires the SET_CLIENT_NONCE_FIXED procedure
# (opcode 0x23) before the first encrypted message can be sent.
#
# CCM uses a 13-byte nonce; GCM/GMAC use 12-byte.  Both can coexist
# (nonce sizing is per key-descriptor record), but this overlay selects
# CCM as the sole AEAD cipher.
#
# PTS tests exercised (combine with a kex overlay):
#   ACS/SR/ACSCP/BV-33-C  Set AC Client Nonce Fixed
#   ACS/SR/ACSCP/BI-09-C  Set AC Client Nonce Fixed — Invalid Operand 1
#   ACS/SR/ACSCP/BI-10-C  Set AC Client Nonce Fixed — Invalid Operand 2
#   ACS/SR/ACSCP/BI-11-C  Set AC Client Nonce Fixed — Invalid Operand 3
#   ACS/SR/GEH/BI-08-C    Invalid Nonce with SEQ_DIFF_FIXED

# Disable the default GCM; PSA deps are auto-selected via Kconfig
CONFIG_BT_ACS_DATA_PROTECTION_AES_GCM=n
CONFIG_BT_ACS_DATA_PROTECTION_AES_GMAC=n

CONFIG_BT_ACS_DATA_PROTECTION_AES_CCM=y
CONFIG_BT_ACS_CCM_NONCE_SEQ_DIFF_FIXED=y
CONFIG_BT_ACS_CCM_NONCE_FIXED_SIZE=8
CONFIG_BT_ACS_CCM_MAC_SIZE=8
```

## overlay-cipher-ccm-evenodd.conf
```kconfig
# AES-128-CCM with SEQ_EVEN_ODD nonce scheme
#
# Replaces the default AES-GCM with AES-128-CCM (AEAD, §3.6) using the
# even/odd sequence number nonce scheme (Table 4.47).  Server uses even
# nonces (0, 2, 4 ...) and client uses odd nonces (1, 3, 5 ...).
# No fixed nonce part — SET_CLIENT_NONCE_FIXED is not applicable.
#
# CCM uses a 13-byte nonce; GCM/GMAC use 12-byte.  Both can coexist
# (nonce sizing is per key-descriptor record), but this overlay selects
# CCM as the sole AEAD cipher.
#
# PTS tests exercised (combine with a kex overlay):
#   ACS/SR/GEH/BI-07-C    Invalid Nonce with SEQ_EVEN_ODD

# Disable the default GCM; PSA deps are auto-selected via Kconfig
CONFIG_BT_ACS_DATA_PROTECTION_AES_GCM=n
CONFIG_BT_ACS_DATA_PROTECTION_AES_GMAC=n

CONFIG_BT_ACS_DATA_PROTECTION_AES_CCM=y
CONFIG_BT_ACS_CCM_NONCE_SEQ_EVEN_ODD=y
CONFIG_BT_ACS_CCM_MAC_SIZE=8
```

## src/main.c
```c
/*
 * SPDX-FileCopyrightText: Copyright The Zephyr Project Contributors
 *
 * SPDX-License-Identifier: Apache-2.0
 */

#include <zephyr/sys/printk.h>
#include <zephyr/kernel.h>
#include <zephyr/settings/settings.h>

#include <zephyr/bluetooth/bluetooth.h>
#include <zephyr/bluetooth/hci.h>
#include <zephyr/bluetooth/conn.h>
#include <zephyr/bluetooth/uuid.h>
#include <zephyr/bluetooth/services/acs.h>
#include <zephyr/bluetooth/services/cts.h>

#include "sample_acs.h"
#include "sample_cts.h"
#include "sample_hrs.h"

/* Map 1, active at start: protects CTS Current Time, every HRS characteristic and, without
 * CONFIG_SAMPLE_ACS_PTS, the two ACS CP procedures below. Its map ISC is 0, so a client
 * without keys reads its descriptor on the plain ACS CP.
 */
BT_ACS_RESTRICTION_MAP_DEFINE(locked_map, SAMPLE_ACS_RMAP_LOCKED_ID,
			      BT_ACS_ISC_ID_NONE,  /* map descriptor */
			      BT_ACS_ISC_ID_NONE); /* resources not listed */
BT_ACS_INITIAL_RESTRICTION_MAP(locked_map);

/* Both procedures act on every client: one ends all established security, the other
 * can turn all protection off (ACS 1.0 Section 4.4.3.14), so only clients with
 * established security may run them. No map protects the procedures a client without
 * keys needs to establish security.
 */
#if IS_ENABLED(CONFIG_SAMPLE_ACS_PTS)
/* PTS layout: map 1 leaves both procedures on the plain ACS CP, and map 2 protects them
 * and Current Time read and write. Requests about map 2 need ACS Data In (ACS 1.0
 * Sections 4.4.3.1, 4.4.3.3).
 */
BT_ACS_RESTRICTION_MAP_DEFINE(relaxed_map, SAMPLE_ACS_RMAP_RELAXED_ID,
			      SAMPLE_ACS_ISC_ID,   /* map descriptor */
			      BT_ACS_ISC_ID_NONE); /* resources not listed */
BT_ACS_PROTECTED_CONTROL_POINT_DEFINE(acs_cp_relaxed, relaxed_map, SAMPLE_ACS_ISC_ID,
				      BT_ACS_CP_OPCODE_INVALIDATE_ALL_ESTABLISHED_SECURITY,
				      BT_ACS_CP_OPCODE_SET_SECURITY_CONTROLS_SWITCH);
#else
BT_ACS_PROTECTED_CONTROL_POINT_DEFINE(acs_cp_locked, locked_map, SAMPLE_ACS_ISC_ID,
				      BT_ACS_CP_OPCODE_INVALIDATE_ALL_ESTABLISHED_SECURITY,
				      BT_ACS_CP_OPCODE_SET_SECURITY_CONTROLS_SWITCH);
#endif

/* Connections with ACS security established, by bt_conn_index(). */
static ATOMIC_DEFINE(secured_conns, CONFIG_BT_MAX_CONN);

static bool any_conn_secured(void)
{
	for (size_t i = 0; i < ARRAY_SIZE(secured_conns); i++) {
		if (atomic_get(&secured_conns[i]) != 0) {
			return true;
		}
	}

	return false;
}

static void acs_security_established(struct bt_conn *conn)
{
	printk("ACS security established with %s\n", bt_conn_dst_str(conn));
	atomic_set_bit(secured_conns, bt_conn_index(conn));
}

static void acs_security_invalidated(struct bt_conn *conn)
{
	printk("ACS security invalidated for %s\n", bt_conn_dst_str(conn));
	atomic_clear_bit(secured_conns, bt_conn_index(conn));
}

static void acs_output_oob_number(struct bt_conn *conn, uint32_t number)
{
	printk("ACS confirmation for %s: show %u to the AC Client\n", bt_conn_dst_str(conn),
	       number);
}

/* No input device, so the tester enters this fixed number on the AC Client. */
#define SAMPLE_ACS_INPUT_OOB_NUMBER 1U

static void acs_input_oob_request(struct bt_conn *conn, enum bt_acs_input_oob_action action)
{
	int err;

	err = bt_acs_input_oob_number(conn, SAMPLE_ACS_INPUT_OOB_NUMBER);
	if (err != 0) {
		printk("ACS confirmation input for %s failed: %d\n", bt_conn_dst_str(conn), err);
		return;
	}

	printk("ACS confirmation input for %s (%s): answered %u\n", bt_conn_dst_str(conn),
	       action == BT_ACS_INPUT_OOB_PUSH ? "push" : "numeric", SAMPLE_ACS_INPUT_OOB_NUMBER);
}

/* ACS calls the confirmation callbacks only for the methods enabled in Kconfig. */
static const struct bt_acs_cb acs_cb = {
	.security_established = acs_security_established,
	.security_invalidated = acs_security_invalidated,
	.output_oob_number = acs_output_oob_number,
	.input_oob_request = acs_input_oob_request,
};

static const struct bt_data ad[] = {
	BT_DATA_BYTES(BT_DATA_FLAGS, (BT_LE_AD_GENERAL | BT_LE_AD_NO_BREDR)),
	BT_DATA_BYTES(BT_DATA_UUID16_ALL, BT_UUID_16_ENCODE(BT_UUID_CTS_VAL),
		      BT_UUID_16_ENCODE(BT_UUID_HRS_VAL), BT_UUID_16_ENCODE(BT_UUID_ACLS_VAL),
		      BT_UUID_16_ENCODE(BT_UUID_DIS_VAL)),
};

static const struct bt_data sd[] = {
	BT_DATA(BT_DATA_NAME_COMPLETE, CONFIG_BT_DEVICE_NAME, sizeof(CONFIG_BT_DEVICE_NAME) - 1),
};

static int start_advertising(void)
{
	return bt_le_adv_start(BT_LE_ADV_CONN_FAST_1, ad, ARRAY_SIZE(ad), sd, ARRAY_SIZE(sd));
}

static void recycled_cb(void)
{
	int err;

	printk("Connection object recycled. Restarting advertising.\n");

	err = start_advertising();
	if (err != 0) {
		printk("Re-advertising failed (err %d)\n", err);
	}
}

static void connected(struct bt_conn *conn, uint8_t err)
{
	if (err != BT_HCI_ERR_SUCCESS) {
		printk("Connection failed, err 0x%02x %s\n", err, bt_hci_err_to_str(err));
		return;
	}

	printk("Connected\n");
}

static void disconnected(struct bt_conn *conn, uint8_t reason)
{
	printk("Disconnected from %s, reason 0x%02x %s\n", bt_conn_dst_str(conn), reason,
	       bt_hci_err_to_str(reason));
}

BT_CONN_CB_DEFINE(conn_callbacks) = {
	.connected = connected,
	.disconnected = disconnected,
	.recycled = recycled_cb,
};

static void auth_passkey_display(struct bt_conn *conn, unsigned int passkey)
{
	printk("Passkey for %s: %06u\n", bt_conn_dst_str(conn), passkey);
}

static void auth_cancel(struct bt_conn *conn)
{
	printk("Pairing cancelled: %s\n", bt_conn_dst_str(conn));
}

static void auth_pairing_complete(struct bt_conn *conn, bool bonded)
{
	printk("Pairing complete: %s, bonded: %s\n", bt_conn_dst_str(conn), bonded ? "yes" : "no");
}

static void auth_pairing_failed(struct bt_conn *conn, enum bt_security_err reason)
{
	printk("Pairing failed: %s, reason %d\n", bt_conn_dst_str(conn), reason);
}

static struct bt_conn_auth_cb auth_cb_display = {
	.passkey_display = auth_passkey_display,
	.cancel = auth_cancel,
};

static struct bt_conn_auth_info_cb auth_info_cb = {
	.pairing_complete = auth_pairing_complete,
	.pairing_failed = auth_pairing_failed,
};

int main(void)
{
	int err;

	printk("ACS + CTS + HRS Peripheral Sample\n");

	err = sample_cts_init();
	if (err != 0) {
		printk("CTS init failed (err %d)\n", err);
		return 0;
	}

	err = sample_hrs_init();
	if (err != 0) {
		printk("HRS init failed (err %d)\n", err);
		return 0;
	}

	err = bt_enable(NULL);
	if (err != 0) {
		printk("Bluetooth init failed (err %d)\n", err);
		return 0;
	}

	printk("Bluetooth initialized\n");

	err = settings_load();
	if (err != 0) {
		printk("Settings load failed (err %d)\n", err);
		return 0;
	}

	err = bt_acs_init(&acs_cb);
	if (err != 0) {
		printk("ACS init failed (err %d)\n", err);
		return 0;
	}

	err = bt_conn_auth_cb_register(&auth_cb_display);
	if (err != 0) {
		printk("Auth callback registration failed (err %d)\n", err);
		return 0;
	}

	err = bt_conn_auth_info_cb_register(&auth_info_cb);
	if (err != 0) {
		printk("Auth info callback registration failed (err %d)\n", err);
		return 0;
	}

	err = start_advertising();
	if (err != 0) {
		printk("Advertising failed to start (err %d)\n", err);
		return 0;
	}

	printk("ACS map %u active: CTS Current Time and HRS need ACS security\n",
	       SAMPLE_ACS_RMAP_LOCKED_ID);

	/* HR every 2 s, CTS every 10 s, while a client has ACS security. ACS sends each value
	 * on Data Out while the active map protects it, as a plain notification otherwise.
	 */
	bool sending = false;
	uint8_t cts_tick = 0U;

	while (true) {
		k_sleep(K_SECONDS(2));

		if (any_conn_secured() != sending) {
			sending = !sending;
			printk("%s heart rate and current time\n",
			       sending ? "Sending" : "Stopped sending");
		}

		if (!sending) {
			continue;
		}

		uint16_t hr = 60 + (uint16_t)((k_uptime_get_32() / 2000) % 40);

		sample_hrs_notify(hr, hr / 30);

		if (++cts_tick >= 5) {
			cts_tick = 0;
			sample_cts_notify(BT_CTS_UPDATE_REASON_UNKNOWN);
		}
	}

	return 0;
}
```

## src/sample_acs.h
```c
/*
 * SPDX-FileCopyrightText: Copyright The Zephyr Project Contributors
 *
 * SPDX-License-Identifier: Apache-2.0
 */

#ifndef SAMPLE_ACS_H_
#define SAMPLE_ACS_H_

#include <zephyr/sys/util.h>
#include <zephyr/bluetooth/services/acs.h>

/* Each choice option depends on the Kconfig enabling its algorithm, so the
 * selected ISC is always compiled in.
 */
#if IS_ENABLED(CONFIG_SAMPLE_ACS_ISC_GCM)
#define SAMPLE_ACS_ISC_ID BT_ACS_ISC_ID_HIGH_SEC_GCM
#elif IS_ENABLED(CONFIG_SAMPLE_ACS_ISC_CCM)
#define SAMPLE_ACS_ISC_ID BT_ACS_ISC_ID_HIGH_SEC_CCM
#elif IS_ENABLED(CONFIG_SAMPLE_ACS_ISC_GMAC)
#define SAMPLE_ACS_ISC_ID BT_ACS_ISC_ID_INTEGRITY_GMAC
#elif IS_ENABLED(CONFIG_SAMPLE_ACS_ISC_CMAC)
#define SAMPLE_ACS_ISC_ID BT_ACS_ISC_ID_MAC_ONLY_CMAC
#else
#error "peripheral_acs requires one of CONFIG_SAMPLE_ACS_ISC_{GCM,CCM,GMAC,CMAC}"
#endif

/* The sample's restriction maps, defined in main.c. The locked map protects CTS
 * Current Time and every HRS characteristic. The relaxed map, registered only
 * with CONFIG_SAMPLE_ACS_PTS, protects Current Time read and write. Only ID 0
 * is reserved (ACS 1.0 Section 4.4.3.2).
 */
#define SAMPLE_ACS_RMAP_LOCKED_ID  1
#define SAMPLE_ACS_RMAP_RELAXED_ID 2

BT_ACS_RESTRICTION_MAP_EXTERN(locked_map);
BT_ACS_RESTRICTION_MAP_EXTERN(relaxed_map);

#endif /* SAMPLE_ACS_H_ */
```

## src/sample_acs_isc.h
```c
/*
 * Copyright (c) 2025 Dipak Shetty
 *
 * SPDX-License-Identifier: Apache-2.0
 */

#ifndef SAMPLE_ACS_ISC_H_
#define SAMPLE_ACS_ISC_H_

#include <zephyr/sys/util.h>
#include <zephyr/bluetooth/services/acs.h>

/* Each choice option depends on the Kconfig enabling its algorithm, so the
 * selected ISC always has a BT_ACS_ISC_DEFINE record compiled in.
 */
#if IS_ENABLED(CONFIG_SAMPLE_ACS_ISC_GCM)
#define SAMPLE_ACS_ISC_ID BT_ACS_ISC_ID_HIGH_SEC_GCM
#elif IS_ENABLED(CONFIG_SAMPLE_ACS_ISC_CCM)
#define SAMPLE_ACS_ISC_ID BT_ACS_ISC_ID_HIGH_SEC_CCM
#elif IS_ENABLED(CONFIG_SAMPLE_ACS_ISC_GMAC)
#define SAMPLE_ACS_ISC_ID BT_ACS_ISC_ID_INTEGRITY_GMAC
#elif IS_ENABLED(CONFIG_SAMPLE_ACS_ISC_CMAC)
#define SAMPLE_ACS_ISC_ID BT_ACS_ISC_ID_MAC_ONLY_CMAC
#else
#error "peripheral_acs requires one of CONFIG_SAMPLE_ACS_ISC_{GCM,CCM,GMAC,CMAC}"
#endif

/* Two policies over the same resources. They differ only in whether the
 * restriction map descriptor itself is protected, which selects the channel
 * carrying Get Restriction Map Descriptor and Activate Restriction Map.
 * Only ID 0 is reserved (ACS 1.0 Section 4.4.3.2).
 */
#define SAMPLE_ACS_RMAP_PUBLIC_ID 1
#define SAMPLE_ACS_RMAP_SECRET_ID 2

#endif /* SAMPLE_ACS_ISC_H_ */
```

## src/sample_cts.c
```c
/*
 * SPDX-FileCopyrightText: Copyright The Zephyr Project Contributors
 *
 * SPDX-License-Identifier: Apache-2.0
 */

#include <time.h>
#include <zephyr/sys/byteorder.h>
#include <zephyr/sys/clock.h>
#include <zephyr/sys/printk.h>
#include <zephyr/bluetooth/services/cts.h>
#include <zephyr/bluetooth/services/acs.h>

#include "sample_acs.h"
#include "sample_cts.h"

BT_ACS_PROTECTED_CHARACTERISTIC_DEFINE(cts_current_time_locked, locked_map,
				       BT_UUID_CTS_CURRENT_TIME, SAMPLE_ACS_ISC_ID,
				       BT_GATT_CHRC_READ | BT_GATT_CHRC_WRITE |
					       BT_GATT_CHRC_NOTIFY);
#if IS_ENABLED(CONFIG_SAMPLE_ACS_PTS)
BT_ACS_PROTECTED_CHARACTERISTIC_DEFINE(cts_current_time_relaxed, relaxed_map,
				       BT_UUID_CTS_CURRENT_TIME, SAMPLE_ACS_ISC_ID,
				       BT_GATT_CHRC_READ | BT_GATT_CHRC_WRITE);
#endif

/* Set once a client writes the time to SYS_CLOCK_REALTIME. */
static bool time_is_set;
/* Adjust Reason of the last write; the CTS helpers do not carry it. */
static uint8_t time_reason = BT_CTS_UPDATE_REASON_UNKNOWN;

static int fill_current_cts_time(struct bt_cts_time_format *cts_time)
{
	struct timespec ts;
	int err;

	if (!time_is_set) {
		static uint8_t seconds;

		cts_time->year = sys_cpu_to_le16(2025);
		cts_time->mon = 1;
		cts_time->mday = 15;
		cts_time->hours = 12;
		cts_time->min = 0;
		cts_time->sec = seconds++;
		cts_time->wday = 3;
		cts_time->fractions256 = 0;
		cts_time->reason = BT_CTS_UPDATE_REASON_UNKNOWN;

		if (seconds >= 60) {
			seconds = 0;
		}

		return 0;
	}

	err = sys_clock_gettime(SYS_CLOCK_REALTIME, &ts);
	if (err != 0) {
		return err;
	}

	err = bt_cts_time_from_unix_ms(cts_time, (int64_t)ts.tv_sec * MSEC_PER_SEC +
							 ts.tv_nsec / NSEC_PER_MSEC);
	if (err != 0) {
		return err;
	}

	cts_time->reason = time_reason;
	return 0;
}

static int cts_time_write_cb(struct bt_cts_time_format *cts_time)
{
	struct timespec ts;
	int64_t unix_ms;
	int err;

	err = bt_cts_time_to_unix_ms(cts_time, &unix_ms);
	if (err != 0) {
		return err;
	}

	ts.tv_sec = unix_ms / MSEC_PER_SEC;
	ts.tv_nsec = (unix_ms % MSEC_PER_SEC) * NSEC_PER_MSEC;

	err = sys_clock_settime(SYS_CLOCK_REALTIME, &ts);
	if (err != 0) {
		return err;
	}

	time_reason = cts_time->reason;
	time_is_set = true;
	printk("CTS time updated: %04u-%02u-%02u %02u:%02u:%02u\n", sys_le16_to_cpu(cts_time->year),
	       cts_time->mon, cts_time->mday, cts_time->hours, cts_time->min, cts_time->sec);
	return 0;
}

static int fill_current_cts_local_time(struct bt_cts_local_time *local_time)
{
	local_time->timezone_offset = BT_CTS_TIMEZONE_DEFAULT_VALUE;
	local_time->dst_offset = BT_CTS_DST_OFFSET_UNKNOWN;
	return 0;
}

static const struct bt_cts_cb cts_cb = {
	.fill_current_cts_time = fill_current_cts_time,
	.cts_time_write = cts_time_write_cb,
	.fill_current_cts_local_time = fill_current_cts_local_time,
};

int sample_cts_init(void)
{
	return bt_cts_init(&cts_cb);
}

void sample_cts_notify(uint8_t reason)
{
	/* Protected by the active map, so ACS sends it on Data Out Notify. */
	(void)bt_cts_send_notification((enum bt_cts_update_reason)reason);
}
```

## src/sample_cts.h
```c
/*
 * SPDX-FileCopyrightText: Copyright The Zephyr Project Contributors
 *
 * SPDX-License-Identifier: Apache-2.0
 */

#ifndef SAMPLE_CTS_H_
#define SAMPLE_CTS_H_

#include <stdint.h>

int sample_cts_init(void);
void sample_cts_notify(uint8_t reason);

#endif /* SAMPLE_CTS_H_ */
```

## src/sample_hrs.c
```c
/*
 * SPDX-FileCopyrightText: Copyright The Zephyr Project Contributors
 *
 * SPDX-License-Identifier: Apache-2.0
 */

#include <errno.h>
#include <zephyr/sys/byteorder.h>
#include <zephyr/sys/printk.h>
#include <zephyr/sys/util.h>
#include <zephyr/bluetooth/gatt.h>
#include <zephyr/bluetooth/services/hrs.h>
#include <zephyr/bluetooth/services/acs.h>

#include "sample_acs.h"
#include "sample_hrs.h"

/* Heart Rate Measurement Flags, bit 3 (HRS 1.0 §3.1.1.1). */
#define HRS_FLAG_ENERGY_EXPENDED_PRESENT 0x08U

/* Only the locked map protects HRS; the relaxed map leaves it unprotected. */
BT_ACS_PROTECTED_CHARACTERISTIC_DEFINE(hrs_body_sensor_locked, locked_map, BT_UUID_HRS_BODY_SENSOR,
				       SAMPLE_ACS_ISC_ID, BT_GATT_CHRC_READ);

BT_ACS_PROTECTED_CHARACTERISTIC_DEFINE(hrs_measurement_locked, locked_map, BT_UUID_HRS_MEASUREMENT,
				       SAMPLE_ACS_ISC_ID, BT_GATT_CHRC_NOTIFY);

/* A plain GATT write is authorized per attribute, so the Control Point is protected whole. */
BT_ACS_PROTECTED_CHARACTERISTIC_DEFINE(hrs_cp_locked, locked_map, BT_UUID_HRS_CONTROL_POINT,
				       SAMPLE_ACS_ISC_ID, BT_GATT_CHRC_WRITE);

static uint32_t energy_expended;

static int hrs_ctrl_point_write(uint8_t request)
{
	if (request == BT_HRS_CONTROL_POINT_RESET_ENERGY_EXPANDED_REQ) {
		energy_expended = 0;
		printk("HRS: Energy Expended reset by client\n");
		return 0;
	}
	return -ENOTSUP;
}

static void hrs_ntf_changed(bool enabled)
{
	printk("HRS notifications %s\n", enabled ? "enabled" : "disabled");
}

static struct bt_hrs_cb hrs_cb = {
	.ctrl_point_write = hrs_ctrl_point_write,
	.ntf_changed = hrs_ntf_changed,
};

int sample_hrs_init(void)
{
	return bt_hrs_cb_register(&hrs_cb);
}

void sample_hrs_notify(uint16_t bpm, uint32_t ee_kj)
{
	uint8_t measurement[4];

	energy_expended = MIN(energy_expended + ee_kj, UINT16_MAX);

	measurement[0] = HRS_FLAG_ENERGY_EXPENDED_PRESENT;
	measurement[1] = (uint8_t)bpm;
	sys_put_le16((uint16_t)energy_expended, &measurement[2]);

	/* Protected by the active map, so ACS sends it on Data Out Notify. */
	(void)bt_gatt_notify_uuid(NULL, BT_UUID_HRS_MEASUREMENT, NULL, measurement,
				  sizeof(measurement));
}
```

## src/sample_hrs.h
```c
/*
 * SPDX-FileCopyrightText: Copyright The Zephyr Project Contributors
 *
 * SPDX-License-Identifier: Apache-2.0
 */

#ifndef SAMPLE_HRS_H_
#define SAMPLE_HRS_H_

#include <stdint.h>

int sample_hrs_init(void);

/* Notify a heart rate in bpm, adding ee_kj to the energy-expended counter. */
void sample_hrs_notify(uint16_t bpm, uint32_t ee_kj);

#endif /* SAMPLE_HRS_H_ */
```
