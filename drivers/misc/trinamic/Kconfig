## drivers/misc/trinamic/Kconfig
```kconfig
# Copyright (c) 2023 Carl Zeiss Meditec AG
# SPDX-License-Identifier: Apache-2.0

config TMC_SPI
	bool
	help
	    If y, the TMC module uses SPI

config TMC_UART
    bool
    help
        If y, the TMC module uses UART

config TRINAMIC
    bool
    help
        If y, the TRINAMIC module is used

config TRINAMIC_SHELL
	bool "Trinamic shell"
	depends on TRINAMIC
	select CBPRINTF_N_SPECIFIER
	default y if !SHELL_MINIMAL
	help
	  This shell provides basic access to trinamic commands to read/write registers.

if TRINAMIC
module = TRINAMIC
module-str = trinamic
source "subsys/logging/Kconfig.template.log_config"
endif



source "drivers/misc/trinamic/tmc5041/Kconfig"
```

## dts/bindings/can/nxp,canfd-flexcan.yaml
```yaml
# Copyright (c) 2022 Carl Zeiss Meditec AG
# SPDX-License-Identifier: Apache-2.0

description: NXP CANFD FlexCAN controller

compatible: "nxp,canfd-flexcan"

include:
    - name: can-fd-controller.yaml
    - name: pinctrl-device.yaml

properties:
    reg:
      required: true

    interrupts:
      required: true

    clocks:
      required: true

    clk-source:
      type: int
      required: true
      description: CAN engine clock source
```

## dts/bindings/can/nxp,flexcan-fd.yaml
```yaml
# Copyright (c) 2022 Carl Zeiss Meditec AG
# SPDX-License-Identifier: Apache-2.0

description: NXP CANFD FlexCAN controller

compatible: "nxp,flexcan-fd"

include:
    - name: can-fd-controller.yaml
    - name: pinctrl-device.yaml

properties:
    reg:
      required: true

    interrupts:
      required: true

    clocks:
      required: true

    clk-source:
      type: int
      required: true
      description: CAN engine clock source
```

## tests/drivers/stepper/drv8424/api/testcase.yaml
```yaml
# Copyright (c) 2024 Navimatix GmbH
# SPDX-License-Identifier: Apache-2.0

tests:
  drivers.stepper.drv8424.api:
    tags:
      - drivers
      - stepper
      - api
      - drv8424
    platform_allow:
      - native_sim
```
